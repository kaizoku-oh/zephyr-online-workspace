## CMakeLists.txt
```
# SPDX-License-Identifier: Apache-2.0

cmake_minimum_required(VERSION 3.20.0)
find_package(Zephyr REQUIRED HINTS $ENV{ZEPHYR_BASE})
project(app)

target_include_directories(app PRIVATE include)
target_include_directories(app PUBLIC ${ZEPHYR_BASE}/../modules/lib/golioth-firmware-sdk/examples/zephyr/common/include)

target_sources(app PRIVATE
  src/main.c
)
```

## prj.conf
```kconfig
# Shell
CONFIG_KERNEL_SHELL=y
CONFIG_SHELL=y

# Debug
CONFIG_DEBUG=y
CONFIG_DEBUG_INFO=y
CONFIG_DEBUG_THREAD_INFO=y
CONFIG_DEBUG_OPTIMIZATIONS=y

# Drivers
CONFIG_ADC=y

# Subsystem
CONFIG_SENSOR=y
```

## boards/nucleo_f767zi.conf
```kconfig
# Networking
CONFIG_NETWORKING=y
CONFIG_NET_LOG=y
CONFIG_NET_SOCKETS=y
CONFIG_NET_SOCKETS_LOG_LEVEL_DBG=n
CONFIG_NET_SOCKETS_POSIX_NAMES=y
CONFIG_NET_SOCKETS_POLL_MAX=4
CONFIG_NET_IPV6=n
CONFIG_NET_IPV4=y
CONFIG_NET_ARP=y
CONFIG_NET_TCP=y
CONFIG_NET_UDP=y
CONFIG_NET_DHCPV4=y
CONFIG_NET_SHELL=y
CONFIG_NET_MGMT=y
CONFIG_NET_MGMT_EVENT=y
CONFIG_NET_MGMT_EVENT_STACK_SIZE=1024
CONFIG_INIT_STACKS=y
CONFIG_SLIP_STATISTICS=n
CONFIG_TEST_RANDOM_GENERATOR=y

# Golioth
CONFIG_GOLIOTH_FIRMWARE_SDK=y
CONFIG_GOLIOTH_SAMPLE_COMMON=y
CONFIG_GOLIOTH_SAMPLE_DHCP_BIND=y
CONFIG_GOLIOTH_SAMPLE_HARDCODED_CREDENTIALS=y
CONFIG_GOLIOTH_SAMPLE_PSK_ID="20240511152824-nucleo-f767zi@chocolate-full-scorpion"
CONFIG_GOLIOTH_SAMPLE_PSK="ba25bae30f68724ba1ea5f5ff2c50cfd"
CONFIG_EVENTFD_MAX=6
CONFIG_POSIX_MAX_FDS=16
```

## src/main.c
```c
/* Lib C */
#include <stdlib.h>
#include <stdbool.h>

/* Zephyr */
#include <zephyr/kernel.h>
#include <zephyr/device.h>
#include <zephyr/drivers/sensor.h>
#include <zephyr/logging/log.h>
LOG_MODULE_REGISTER(main);

static const struct device *temperature_dev = DEVICE_DT_GET(DT_NODELABEL(die_temp));

int main(void)
{
  int ret = 0;
  struct sensor_value value = {0};

  /* Check if internal temperature sensor is ready to be used */
  if (!device_is_ready(temperature_dev)) {
    LOG_ERR("Temperature device is not ready");
    while (true);
  }

  /* Periodically fetch data from sensor */
  while (true)
  {
    ret = sensor_sample_fetch(temperature_dev);
    if (ret) {
      LOG_ERR("Failed to fetch sample (%d)", ret);
      while (true);
    }
    ret = sensor_channel_get(temperature_dev, SENSOR_CHAN_DIE_TEMP, &value);
    if (ret) {
      LOG_ERR("Failed to get data (%d)", ret);
      while (true);
    }
    LOG_INF("CPU temperature: %.1f °C", sensor_value_to_double(&value));
    k_msleep(1000);
  }

  return EXIT_FAILURE;
}
```

## src/app_cloud.c
```c
/* Lib C */
#include <stdlib.h>
#include <stdbool.h>

/* Zephyr */
#include <zephyr/kernel.h>
#include <zephyr/device.h>
#include <zephyr/drivers/sensor.h>
#include <zephyr/logging/log.h>
LOG_MODULE_REGISTER(main);

/* Golioth */
#include <golioth/client.h>
#include <samples/common/net_connect.h>
#include <samples/common/sample_credentials.h>

static K_SEM_DEFINE(connected, 0, 1);
static struct golioth_client *client = NULL;
static const struct device *temperature_dev = DEVICE_DT_GET(DT_NODELABEL(die_temp));

static void on_client_event(struct golioth_client *client, enum golioth_client_event event, void *arg);

int main(void)
{
  int ret = 0;
  struct sensor_value value = {0};
  const struct golioth_client_config *client_config = golioth_sample_credentials_get();

  /* Connect to LAN (get an IP address from DHCP) */
  net_connect();

  /* Create client and start connecting to Golioth cloud */
  client = golioth_client_create(client_config);
  golioth_client_register_event_callback(client, on_client_event, NULL);

  /* Wait forever for connection flag */
  k_sem_take(&connected, K_FOREVER);

  /* Check if internal temperature sensor is ready to be used */
  if (!device_is_ready(temperature_dev)) {
    LOG_ERR("Temperature device is not ready");
    while (true);
  }

  /* Periodically fetch data from sensor */
  while (true)
  {
    ret = sensor_sample_fetch(temperature_dev);
    if (ret) {
      LOG_ERR("Failed to fetch sample (%d)", ret);
      while (true);
    }
    ret = sensor_channel_get(temperature_dev, SENSOR_CHAN_DIE_TEMP, &value);
    if (ret) {
      LOG_ERR("Failed to get data (%d)", ret);
      while (true);
    }
    LOG_INF("CPU temperature: %.1f °C", sensor_value_to_double(&value));
    k_msleep(1000);
  }

  return EXIT_FAILURE;
}

static void on_client_event(struct golioth_client *client, enum golioth_client_event event, void *arg)
{
  bool is_connected = (event == GOLIOTH_CLIENT_EVENT_CONNECTED);

  if (is_connected)
  {
    k_sem_give(&connected);
  }
  LOG_INF("Golioth client %s", is_connected ? "connected" : "disconnected");
}
```
